## config/boards/shields/vega/Kconfig.defconfig
```kconfig
config ZMK_BLE
	default y

config ZMK_USB
	default y

if SHIELD_VEGA_RIGHT

config ZMK_SPLIT_BLE_ROLE_CENTRAL
	default y

endif # SHIELD_VEGA_RIGHT

if SHIELD_VEGA_LEFT || SHIELD_VEGA_RIGHT

config ZMK_KEYBOARD_NAME
	default "_vega"

config ZMK_SPLIT
	default y

endif # SHIELD_VEGA_LEFT || SHIELD_VEGA_RIGHT
```

## config/boards/shields/vega/Kconfig.shield
```kconfig
config SHIELD_VEGA_LEFT
	def_bool $(shields_list_contains,vega_left)

config SHIELD_VEGA_RIGHT
	def_bool $(shields_list_contains,vega_right)
```
